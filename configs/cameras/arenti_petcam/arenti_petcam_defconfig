## package/petcam-audio-alarm/Config.in
```kconfig
config BR2_PACKAGE_PETCAM_AUDIO_ALARM
	bool "petcam-audio-alarm"
	depends on BR2_USE_MMU
	depends on BR2_PACKAGE_THINGINO_RAPTOR
	help
	  Baby-monitor style audio watchdog: reads the live mic feed via the
	  Raptor "rac" tool, decodes it, and fires send2 alerts (email etc.)
	  plus an rmr recording on a sustained loud-sound excursion above the
	  room's rolling ambient level. Requires thingino-raptor (rac, rmr,
	  send2*).
```

## package/petcam-tools/Config.in
```kconfig
config BR2_PACKAGE_PETCAM_TOOLS
	bool "petcam-tools"
	depends on BR2_USE_MMU
	help
	  Custom stepper-motor driver (agitator) and treat-dispense-cycle
	  script for the petcam pet feeder board. Not useful on stock camera
	  boards without the feeder hardware.
```
